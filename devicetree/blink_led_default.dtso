/dts-v1/;
/plugin/;

/ {
	fragment@1 {

		target-path = "/soc/base_fpga_region/fpga_pr_region0";
		#address-cells = <0x1>;
		#size-cells = <0x1>;

		__overlay__ {
			partial-fpga-config;
			firmware-name = "blink_led_default.pr_partition.rbf";
			#address-cells = <0x2>;
			#size-cells = <0x1>;
			region-unfreeze-timeout-us = <0x4>;
			region-freeze-timeout-us = <0x4>;
		};
	};
};
