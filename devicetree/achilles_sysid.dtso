/dts-v1/;
/plugin/;

/ {
	fragment@0 {

		target-path = "/soc/base_fpga_region";
		#address-cells = <0x1>;
		#size-cells = <0x1>;

		__overlay__ {
			ranges = <0x00000000 0x00000000 0xc0000000 0x3C000000>,
			         <0x00000001 0x00000000 0xff200000 0x00200000>;
			external-fpga-config;
			#address-cells = <0x2>;
			#size-cells = <0x1>;

			sysid@100000000 {
				compatible = "altr,sysid-1.0";
				reg = <0x1 0x0 0x8>;
			};
		};
	};
};
