/dts-v1/;
/plugin/;

&{/soc/base_fpga_region} {

	ranges = <0xc0000000 0xc0000000 0x3C000000>,
			 <0x00000000 0xff200000 0x00200000>;

	external-fpga-config;

	#address-cells = <0x1>;
	#size-cells = <0x1>;

	fpga_pr_region0 {
		compatible = "fpga-region";
		fpga-bridges = <&freeze_controller_0>;
	};

	freeze_controller_0: freeze_controller@00001000 {
		compatible = "altr,freeze-bridge-controller";
		reg = <0x00001000 0x00000010>;
	};
};
